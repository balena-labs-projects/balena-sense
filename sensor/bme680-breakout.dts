/dts-v1/;
/plugin/;

&i2c1 {
  status = "okay";
  #address-cells = <1>;
  #size-cells = <0>;

  /* Define the BME680 pressure sensor at address 0x76 */
  bme680@76 {
    compatible = "bosch,bme680";
    reg = <0x76>;
  };
};
